VERSION ""

NS_ :

BS_:

BU_:

BO_ 2147483650 can_fd_ext: 64 Vector__XXX
 SG_ fd : 64|8@1+ (1,0) [10|11] "" Vector__XXX
 SG_ extended : 16|8@1+ (1,0) [5|10] "" Vector__XXX
 SG_ base : 0|8@1+ (1,0) [1|5] "" Vector__XXX

BO_ 4 can_fd_std: 64 Vector__XXX
 SG_ fd : 80|8@1+ (1,0) [10|11] "" Vector__XXX
 SG_ base : 0|8@1+ (1,0) [1|5] "" Vector__XXX

BO_ 2147483651 can_fd_ext_brs: 64 Vector__XXX
 SG_ fd : 64|8@1+ (1,0) [10|11] "" Vector__XXX
 SG_ extended : 16|8@1+ (1,0) [5|10] "" Vector__XXX
 SG_ brs : 88|8@1+ (1,0) [20|30] "" Vector__XXX
 SG_ base : 0|8@1+ (1,0) [1|5] "" Vector__XXX

BO_ 1 can_fd_std_brs: 64 Vector__XXX
 SG_ fd : 104|8@1+ (1,0) [10|11] "" Vector__XXX
 SG_ brs : 80|8@1+ (1,0) [20|30] "" Vector__XXX
 SG_ base : 0|8@1+ (1,0) [1|5] "" Vector__XXX

BO_ 2147483666 can_ext: 8 Vector__XXX
 SG_ extended : 8|8@1+ (1,0) [5|10] "" Vector__XXX
 SG_ base : 0|8@1+ (1,0) [1|5] "" Vector__XXX

BO_ 17 can_std: 8 Vector__XXX
 SG_ base : 0|8@1+ (1,0) [1|5] "" Vector__XXX

BA_DEF_ BO_  "CANFD_BRS" ENUM  "0","1";
BA_DEF_  "DBName" STRING ;
BA_DEF_  "BusType" STRING ;
BA_DEF_ BO_  "VFrameFormat" ENUM  "StandardCAN","ExtendedCAN","reserved","reserved","reserved","reserved","reserved","reserved","reserved","reserved","reserved","reserved","reserved","reserved","StandardCAN_FD","ExtendedCAN_FD";
BA_DEF_DEF_  "CANFD_BRS" "1";
BA_DEF_DEF_  "DBName" "";
BA_DEF_DEF_  "BusType" "";
BA_DEF_DEF_  "VFrameFormat" "StandardCAN";
BA_ "BusType" "CAN FD";
BA_ "DBName" "pingerfd";
BA_ "CANFD_BRS" BO_ 2147483650 0;
BA_ "VFrameFormat" BO_ 2147483650 15;
BA_ "CANFD_BRS" BO_ 4 0;
BA_ "VFrameFormat" BO_ 4 14;
BA_ "VFrameFormat" BO_ 2147483651 15;
BA_ "VFrameFormat" BO_ 1 14;
BA_ "VFrameFormat" BO_ 2147483666 1;
